// Arduino based Canbus converter
// Z33 Canbus TACH and Coolant Conversion module
// Designed to take signals from VR30 and transmit them to Z33 dash amplifier. 


#include <SPI.h>
#include <mcp_can.h>


int stringSplit(char *str, const char *delim, int data[]);
bool gotdata;

//Relay Definitions
int lowRelay = 4;
int medRelay = 5;
int highRelay = 6;
volatile byte lowState = LOW;
volatile byte medState = LOW;
volatile byte highState = LOW;


//Might be bad form, but the final buffer lives here globally
static unsigned char finalbuffer[8]={0,0,0,0,0,0,0,0};
static unsigned char vr30speedbuffer[8]={0,0,0,0,48,0,96,0};
//using a master time to prevent issues with fans turning on and immediately off
long mastertime = 0;
long masterdelay = 35000;

// the cs pin of the version after v1.1 is default to D9
// v0.9b and v1.0 is default D10
const int SPI_CS_PIN = 3;
MCP_CAN CAN(SPI_CS_PIN);                                    // Set CS pin

void setup()
{
    Serial.begin(115200);
    CanbusStart();
    //Relay Setup Section
    pinMode(lowRelay, OUTPUT);
    pinMode(medRelay, OUTPUT);
    pinMode(highRelay, OUTPUT);
    //HIGH is off.
    digitalWrite(lowRelay, HIGH);
    digitalWrite(medRelay, HIGH);
    digitalWrite(highRelay, HIGH);
}

// start canbus shield
void CanbusStart(void)
{
    Serial.println("Canbus monitor");
    while (CAN_OK != CAN.begin(CAN_500KBPS))              // init can bus : baudrate = 500k
    {
        Serial.println("CAN BUS Shield init fail");
        Serial.println(" Init CAN BUS Shield again");
        delay(100);
    }
    CAN.init_Mask(0, 0, 0x7FF);
    CAN.init_Mask(1, 0, 0x7FF);
    CAN.init_Mask(2, 0, 0x7FF);
    //This filter is setup to cut down on the noise generated by the VR30 ECU.  Only listens for ABS,TACH and Coolant CanIDs.
    //Filters are for x1F9 and x551
    CAN.init_Filt(0, 0, 0x1F9);
    CAN.init_Filt(1, 0, 0x551);
    CAN.init_Filt(2, 0, 0x284);
    Serial.println("CAN BUS Shield init ok!");
}

void loop()
{
    //Serial.println("Live Arduino.");
    // check for received message
    gotdata = false;
    //fancheck(148);
    unsigned char len = 0;
    unsigned char buf[8]={0};
    char capturetext[16]={0};
    //Unsigned cause Arduino likes to go signed 2's in hex... dunno why.
    static unsigned int capbuffera[8]={0,0,0,0,0,0,0,0};
    static unsigned int capbufferb[8]={0,0,0,0,0,0,0,0};
    static unsigned int capbufferc[8]={0,0,0,0,0,0,0,0};
    if(CAN_MSGAVAIL == CAN.checkReceive())            // check if data coming
    {
        //Serial.println("Got Data");
        CAN.readMsgBuf(&len, buf);    // read data,  len: data length, buf: data buf
        unsigned long int canId = CAN.getCanId();
        char text[50]={0};
        // setup standard 11 bit or extended 29 bit frame and add ID value
        sprintf(&text[strlen(text)],"ID %08lx ", canId);
        //Serial.println(canId);
        //this will capture HEX.
        //Tach Frame Captured Here
        
        if (canId == 0x1F9){
            for (int i=0; i<8; i++)
            {
              capturetext[0]=0;;
              sprintf(capturetext, "%02X", buf[i]);
              //Serial.print(capturetext);
              capbuffera[i] = strtoul(capturetext, NULL, 16);
              gotdata = true;  
            }
        }
        // Coolant Frame Here
        if (canId == 0x551){
            for (int i=0; i<8; i++)
            {
              capturetext[0]=0;;
              sprintf(capturetext, "%02X", buf[i]);
              //Serial.print(capturetext);
              capbufferb[i] = strtoul(capturetext, NULL, 16);
              gotdata = true;  
            }    
        }
        //ABS Capture goes here, we're going to create a new MSG later.
        if (canId == 0x284) {
           Serial.println(canId);
           Serial.print(capturetext);
           for (int i=0; i<8; i++){
              capturetext[0]=0;;
              sprintf(capturetext, "%02X", buf[i]);
              Serial.print(capturetext);
              capbufferc[i] = strtoul(capturetext, NULL, 16);
              gotdata = true;  
           }
        }
        //Convert 1F9 Tach Message to 23D Tach Message
        convertRPM(capbuffera[2],capbuffera[3]);
        //Toss the Coolant message into 23D
        convertCool(capbufferb[0]);
        convertABS(capbufferc[4],capbufferc[5]);
        //Serial.println(canId);
        for(int i = 0; i<8; i++)    // print the data       
        {
            text[0]=0;;
            sprintf(text,"%02X", buf[i]);
            //Serial.print(text);
            //Serial.println(canId);
            //Serial.print(buf[i], HEX);
        }
        
        Serial.println();
    }
    if (gotdata ==  true){
      // this code will only fire if valid data was receieved.  This keeps the device from blasting the CANBUS with needless noise.
      // Some sort of internal counter used by the Z33 dash.
      if (finalbuffer[0] >= 60){
        finalbuffer[0] = 0;
      }
      else {
        finalbuffer[0] = finalbuffer[0] + 20;
      }
      CAN.sendMsgBuf(0x23D, 0, 0, 8, finalbuffer);
      //Coolant Fan Control
      fancheck(capbufferb[0]);
      //ABS to Cluster Message recreation (This fakes the message that comes from the VR30 cluster that the ECU and Trans are looking for.)
      CAN.sendMsgBuf(0x355, 0, 0, 8, vr30speedbuffer);
      } 
      
}

void convertRPM(unsigned int tacha, unsigned int tachb){
   //First convert the 1F9 signal into a raw number using the two TACH inputs
   //This is a partial HEX conversion, but the TACH is not a 1 to 1 HEX input.
   //So the MSB set to 01 equals roughly 768 RPM on the tach.  The conversion below is not 100% and could be improved but right now its close enough
   int rawrpm = (((tacha * 256) + tachb)/4)/2;
   //Serial.println();
   //Serial.print("Tach A:");
   //Serial.println(tacha);
   //Serial.print("Tach B:");
   //Serial.println(tachb);
   int parta = 0;
   int partb = 0;

   // I think there is an edge case are intial turn on that causes an negative value to show up.
  if (!(rawrpm - 128 < 0)){
    parta = (rawrpm - 128) / 768;
    partb = ((rawrpm - 128) - (parta*768))/3;
    if (partb > 256){
     parta += 1;
     partb -= 255;
    }
  }
   
   finalbuffer[3]=partb;
   finalbuffer[4]=parta;
}

void convertCool(unsigned int coolant){
  finalbuffer[7]= coolant;
}

void convertABS(unsigned int vehspeeda, unsigned int vehspeedb){
  //Takes the message from the ABS system and sends it out an unused in the Z33 CAN message ID for the VR30 ECU and AutoTrans to listen to.
  vr30speedbuffer[0]=vehspeeda;
  vr30speedbuffer[1]=vehspeedb;
}

int fancheck(unsigned int coolant) {
  //Based on how high the coolant temp is, trigger relays
  //Proper CANID for the Z33 is 1F9 first bit... However the VR30 ECU blasts this address constantly.  The IPDM doesn't have the ability to ignore any messages without a gateway installed.
  //So this is being used on a relay board instead of the CAN message.  
  //Low = 64
  //Medium = 128
  //High= 192
  int off = 00;
  int low = 64;
  int medium = 128;
  int high = 192;
    
  //Serial.println();
  //Serial.print("Coolant Reading: ");
  //Serial.print(coolant);
  if (coolant > 138 && coolant < 142){
    //low+
    Serial.println();
    Serial.print("Coolant Fan Speed: Low");
    //mastertime = millis();
    if (lowState == LOW){
      lowState = HIGH;
      digitalWrite(lowRelay, LOW);
      mastertime = millis();
    }
    if (medState == HIGH){
      digitalWrite(medRelay, HIGH);
      medState = LOW;
    }
    //return low;
  }
  else if (coolant < 143 && coolant > 145){
    //medium
    Serial.println();
    Serial.print("Coolant Fan Speed: Medium");
    if ((medState == LOW) && (lowState == HIGH)){
      medState = HIGH;
      digitalWrite(medRelay, LOW);
      mastertime = millis();
    }
    if ((medState == LOW) && (lowState == LOW)){
      medState = HIGH;
      digitalWrite(medRelay, LOW);
      lowState = HIGH;
      digitalWrite(lowRelay, LOW);
      mastertime = millis();
    }
    //return medium;
  }
  else if (coolant > 146){
    //high 
    Serial.println();
    Serial.print("Coolant Fan Speed: High");
    if ((highState == LOW) && (lowState == HIGH) && (medState == HIGH)){
      highState = HIGH;
      digitalWrite(highRelay, LOW);
      mastertime = millis();
    }
    if ((highState == LOW) && (lowState == LOW) && (medState == LOW)){
      highState = HIGH;
      digitalWrite(highRelay, LOW);
      medState = HIGH;
      digitalWrite(medRelay, LOW);
      lowState = HIGH;
      digitalWrite(lowRelay, LOW);
      mastertime = millis();
    }
    if ((highState == LOW) && (lowState == HIGH) && (medState == LOW)){
      highState = HIGH;
      digitalWrite(highRelay, LOW);
      medState = HIGH;
      digitalWrite(medRelay, LOW);
      mastertime = millis();
    }
    if ((highState == LOW) && (lowState == LOW) && (medState == HIGH)){
      highState = HIGH;
      digitalWrite(highRelay, LOW);
      lowState = HIGH;
      digitalWrite(lowRelay, LOW);
      mastertime = millis();
    }
    //return high;
  }
  //else {
    //off with a delay to prevent fans from quickly cycling needlessly.
    //Serial.print(mastertime);
  //  if (lowState = HIGH){
      //Only start counting if the fans were previously running, keeps the counter from being oddly short. 
  //    mastertime++;
  //  }
     
    if ((lowState == HIGH) && (coolant < 128)){
      Serial.println();
      Serial.print("Coolant Fan Speed: Off");
      //Turn them all off.
      digitalWrite(lowRelay, HIGH);
      lowState = LOW;
      digitalWrite(medRelay, HIGH);
      medState = LOW;
      digitalWrite(highRelay, HIGH);
      highState = LOW;
      mastertime = 0; 
    //return off; 
    }
  }
